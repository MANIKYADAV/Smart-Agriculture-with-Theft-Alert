## conf/bblayers.conf
```bitbake
# POKY_BBLAYERS_CONF_VERSION is increased each time build/conf/bblayers.conf
# changes incompatibly
POKY_BBLAYERS_CONF_VERSION = "2"

BBPATH = "${TOPDIR}"
BBFILES ?= ""

BBLAYERS ?= " \
  /home/kondal/yocto_labs/poky/meta \
  /home/kondal/yocto_labs/poky/meta-poky \
  /home/kondal/yocto_labs/poky/meta-yocto-bsp \
  /home/kondal/yocto_labs/meta-raspberrypi \
  /home/kondal/yocto_labs/meta-openembedded/meta-oe \
  /home/kondal/yocto_labs/meta-openembedded/meta-python \
  /home/kondal/yocto_labs/meta-openembedded/meta-networking \
  /home/kondal/yocto_labs/meta-openembedded/meta-multimedia \
  /home/kondal/yocto_labs/meta-BKM-5 \
  "
```

## meta/conf/layer.conf
```bitbake
# We have a conf and classes directory, add to BBPATH
BBPATH .= ":${LAYERDIR}"

# We have recipes-* directories, add to BBFILES
BBFILES += "${LAYERDIR}/recipes-*/*/*.bb \
            ${LAYERDIR}/recipes-*/*/*.bbappend"

BBFILE_COLLECTIONS += "meta-BKM-5"
BBFILE_PATTERN_meta-BKM-5 = "^${LAYERDIR}/"
BBFILE_PRIORITY_meta-BKM-5 = "6"

LAYERDEPENDS_meta-BKM-5 = "core"
LAYERSERIES_COMPAT_meta-BKM-5 = "kirkstone"
```
